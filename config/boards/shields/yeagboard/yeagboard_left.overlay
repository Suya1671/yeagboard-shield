/*
* SPDX-License-Identifier: MIT
*/

#include "yeagboard.dtsi"

/{
    kscan0: kscan {
        compatible = "zmk,kscan-gpio-direct";
        wakeup-source;
        // Index 0 = SW1 = RC(0,0)
        input-gpios
            = <&gpio0 2 (GPIO_ACTIVE_LOW | GPIO_PULL_UP)> // SW1
            , <&gpio0 8 (GPIO_ACTIVE_LOW | GPIO_PULL_UP)> // SW2
            , <&gpio0 29 (GPIO_ACTIVE_LOW | GPIO_PULL_UP)> // SW3
            , <&gpio0 6 (GPIO_ACTIVE_LOW | GPIO_PULL_UP)> // SW4
            , <&gpio0 31 (GPIO_ACTIVE_LOW | GPIO_PULL_UP)> // SW5
            , <&gpio0 20 (GPIO_ACTIVE_LOW | GPIO_PULL_UP)> // SW6
            , <&gpio1 13 (GPIO_ACTIVE_LOW | GPIO_PULL_UP)> // SW7
            , <&gpio0 17 (GPIO_ACTIVE_LOW | GPIO_PULL_UP)> // SW8
            , <&gpio1 15 (GPIO_ACTIVE_LOW | GPIO_PULL_UP)> // SW9
            , <&gpio0 22 (GPIO_ACTIVE_LOW | GPIO_PULL_UP)> // SW10
            , <&gpio1 4 (GPIO_ACTIVE_LOW | GPIO_PULL_UP)> // SW11
            , <&gpio0 11 (GPIO_ACTIVE_LOW | GPIO_PULL_UP)> // SW12
            , <&gpio1 0 (GPIO_ACTIVE_LOW | GPIO_PULL_UP)> // SW13
            , <&gpio0 24 (GPIO_ACTIVE_LOW | GPIO_PULL_UP)> // SW14
            , <&gpio1 6 (GPIO_ACTIVE_LOW | GPIO_PULL_UP)> // SW15
            , <&gpio1 1 (GPIO_ACTIVE_LOW | GPIO_PULL_UP)> // SW16
            , <&gpio1 2 (GPIO_ACTIVE_LOW | GPIO_PULL_UP)> // SW17
            , <&gpio1 7 (GPIO_ACTIVE_LOW | GPIO_PULL_UP)> // SW18
            ;
    };
};