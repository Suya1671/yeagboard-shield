## config/boards/shields/yeagboard/Kconfig.shield
```kconfig
config SHIELD_YEAGBOARD_LEFT
    def_bool $(shields_list_contains,yeagboard_left)

config SHIELD_YEAGBOARD_RIGHT
    def_bool $(shields_list_contains,yeagboard_right)
```
